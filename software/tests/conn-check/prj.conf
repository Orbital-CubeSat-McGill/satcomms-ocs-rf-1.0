## CMakeLists.txt
```
cmake_minimum_required(VERSION 3.20.0)

# Where the ocs_rf_1 board definition lives
list(APPEND BOARD_ROOT ${CMAKE_CURRENT_LIST_DIR}/../..)

# Import the driver as a Zephyr module. This has to come before find_package(Zephyr)
list(APPEND ZEPHYR_EXTRA_MODULES ${CMAKE_CURRENT_LIST_DIR}/../../module/at68rf215)

find_package(Zephyr REQUIRED HINTS $ENV{ZEPHYR_BASE})
project(conn-check)

target_sources(app PRIVATE src/main.c)
```

## prj.conf
```kconfig
CONFIG_PRINTK=y

# Show the driver's init errors on the console
CONFIG_LOG=y
CONFIG_LOG_MODE_MINIMAL=y

# Run main above the system workqueue (-1). If the radio's IRQ line gets stuck
# high, the driver's IRQ work runs back to back and would otherwise starve main,
# leaving a silent console in exactly the case this test needs to report.
CONFIG_MAIN_THREAD_PRIORITY=-2
```

## src/main.c
```c
/*
 * Hardware test for the at86rf215 driver's SPI path.
 *
 * Reads the part number register through conn_check once a second and prints
 * the result. Console is 115200 8N1. The radio is never told to transmit.
 *
 * ret=0 part=0x34       AT86RF215 answered (0x35 is the IQ, 0x36 the M variant)
 * ret=-6 part=0x00/0xff nothing is answering (SPI has no ack): check power,
 *                       reset, CS, SCK, MOSI and MISO
 * ret=-6 part=other     something answered but the bits are wrong: check for
 *                       clock mode or signal integrity problems
 * "not ready"           the driver's init failed, see the log line above it
 */
#include <zephyr/device.h>
#include <zephyr/devicetree.h>
#include <zephyr/kernel.h>
#include <zephyr/sys/printk.h>

#include "rf215.h"

static const struct device *const radio = DEVICE_DT_GET(DT_NODELABEL(at86rf215));

int main(void)
{
    const struct rf215_api *api = radio->api;
    unsigned int count = 0;

    while (1) {
        if (device_is_ready(radio)) {
            uint8_t part = 0;
            int ret = api->conn_check(radio, &part);

            printk("[%u] conn_check ret=%d part=0x%02x\n", count, ret, part);
        } else {
            printk("[%u] AT86RF215 not ready, driver init failed\n", count);
        }

        count++;
        k_msleep(1000);
    }

    return 0;
}
```
