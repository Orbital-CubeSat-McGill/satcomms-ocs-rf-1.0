## CMakeLists.txt
```
cmake_minimum_required(VERSION 3.20.0)

# Where the ocs_rf_1 board definition lives
list(APPEND BOARD_ROOT ${CMAKE_CURRENT_LIST_DIR}/../..)

# Import the driver as a Zephyr module. This has to come before find_package(Zephyr)
list(APPEND ZEPHYR_EXTRA_MODULES ${CMAKE_CURRENT_LIST_DIR}/../../module/at68rf215)

find_package(Zephyr REQUIRED HINTS $ENV{ZEPHYR_BASE})
project(build-test)

target_sources(app PRIVATE src/main.c)
```

## Kconfig
```
mainmenu "Satcomms OCS Initial Test"

rsource "../../drivers/Kconfig"

source "Kconfig.zephyr"
```

## prj.conf
```kconfig
# Enable console printing and GPIO
CONFIG_PRINTK=y
CONFIG_GPIO=y
CONFIG_SPI=y
CONFIG_EVENTS=y
```

## src/main.c
```c
/*
 * Build test for the at86rf215 module.
 *
 * Referencing the device and its API means this only links if the module was
 * imported and the driver instance was actually compiled in.
 */
#include <zephyr/device.h>
#include <zephyr/devicetree.h>
#include <zephyr/sys/printk.h>
#include <errno.h>

#include "rf215.h"

static const struct device *const radio = DEVICE_DT_GET(DT_NODELABEL(at86rf215));

int main(void)
{
    if (!device_is_ready(radio)) {
        printk("AT86RF215 not ready\n");
        return -ENODEV;
    }

    const struct rf215_api *api = radio->api;
    uint8_t part = 0;
    int ret = api->conn_check(radio, &part);

    printk("AT86RF215 conn_check: %d, part: 0x%02x\n", ret, part);

    return ret;
}
```
