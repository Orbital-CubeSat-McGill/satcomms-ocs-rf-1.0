## CMakeLists.txt
```
cmake_minimum_required(VERSION 3.20.0)

get_filename_component(OCS_RF_ROOT "${CMAKE_CURRENT_SOURCE_DIR}/../../.." ABSOLUTE)
list(APPEND BOARD_ROOT ${OCS_RF_ROOT})
list(APPEND DTS_ROOT ${OCS_RF_ROOT})
if(NOT DEFINED DTC_OVERLAY_FILE)
    set(DTC_OVERLAY_FILE "${OCS_RF_ROOT}/app.overlay")
endif()

find_package(Zephyr REQUIRED HINTS $ENV{ZEPHYR_BASE})
project(ocs_radio_spi_bringup)
target_include_directories(app PRIVATE
    ${OCS_RF_ROOT}/include
    ${OCS_RF_ROOT}/src/radio
)
target_sources(app PRIVATE
    src/main.c
    ${OCS_RF_ROOT}/src/radio/ocs_radio.c
    ${OCS_RF_ROOT}/src/radio/at86rf215.c
    ${OCS_RF_ROOT}/src/radio/at86rf215_packet.c
    ${OCS_RF_ROOT}/src/radio/at86rf215_zephyr.c
)
```

## prj.conf
```kconfig
CONFIG_GPIO=y
CONFIG_SPI=y
CONFIG_PRINTK=y
CONFIG_SAM0_EIC=y
CONFIG_MAIN_STACK_SIZE=2048
```

## src/main.c
```c
#include <errno.h>

#include <zephyr/kernel.h>
#include <zephyr/sys/printk.h>

#include <ocs/radio.h>

static int run_checks(void)
{
    int result = ocs_radio_init();

    if (result != 0) {
        printk("FAIL simple API init/presence check: %d\n", result);
        return result;
    }

    printk("PASS simple API init/presence check\n");

    /* Read the radio's read-only part-number register over real SPI. */
    uint8_t part_number;

    result = ocs_radio_read_reg(
        OCS_RADIO_REG_PN,
        &part_number
    );

    if (result != 0) {
        printk("FAIL RF_PN register read: %d\n", result);
        return result;
    }

    printk(
        "RF_PN register 0x%04x: read=0x%02x expected=0x34\n",
        (unsigned int)OCS_RADIO_REG_PN,
        (unsigned int)part_number
    );

    uint8_t id[2];

    result = ocs_radio_read(
        OCS_RADIO_REG_PN,
        id,
        sizeof(id)
    );

    if (result != 0) {
        printk("FAIL ID read: %d\n", result);
        return result;
    }

    printk(
        "PN=0x%02x VN=0x%02x\n",
        (unsigned int)id[0],
        (unsigned int)id[1]
    );

    if (part_number != 0x34 || id[0] != 0x34) {
        printk("FAIL unexpected part number\n");
        return -ENODEV;
    }

    printk("PASS part-number register read\n");
    printk("PASS identification and block read\n");

    return 0;
}

int main(void)
{
    k_msleep(1500);

    printk("OCS RF SPI identification: SAMD21 + AT86RF215\n");

    int result = run_checks();

    printk(
        "BRING-UP %s (%d)\n",
        result == 0 ? "PASS" : "FAIL",
        result
    );

    for (;;) {
        printk(
            "Alive: PN/VN check %s; reset to run again\n",
            result == 0 ? "PASS" : "FAIL"
        );

        k_msleep(5000);
    }

    return 0;
}
```
