## software/boards/ocs_rf_1/Kconfig.ocs_rf_1
```kconfig
# Copyright (c) 2018 Bryan O'Donoghue
# Copyright (c) 2024 Gerson Fernando Budke <nandojve@gmail.com>
# SPDX-License-Identifier: Apache-2.0

config BOARD_OCS_RF_1
	select SOC_SAMD21G17A
```

## software/boards/ocs_rf_1/board.yml
```yaml
board:
  name: ocs_rf_1
  full_name: OCS RF 1
  vendor: atmel
  socs:
    - name: samd21g17a
```

## software/boards/ocs_rf_1/ocs_rf_1_defconfig
```kconfig
# Copyright (c) 2018 Bryan O'Donoghue
# Copyright (c) 2024 Gerson Fernando Budke <nandojve@gmail.com>
# SPDX-License-Identifier: Apache-2.0

CONFIG_BUILD_OUTPUT_HEX=y

CONFIG_CONSOLE=y
CONFIG_SERIAL=y
CONFIG_UART_CONSOLE=y
CONFIG_UART_INTERRUPT_DRIVEN=y
```

## software/drivers/at86rf215/Kconfig
```kconfig
config IEEE802154_AT86RF215
	bool "AT86RF215 IEEE 802.15.4 Transceiver driver"
	default y
	help
	  Enable support for the Microchip/Atmel AT86RF215 transceiver driver.
```

## software/dts/bindings/atmel,at86rf215.yaml
```yaml
description: Atmel AT86RF215 Dual-band IEEE 802.15.4 / Sub-GHz Transceiver

compatible: "atmel,at86rf215"

include: spi-device.yaml

properties:
  irq-gpios:
    type: phandle-array
    required: true
    description: |
      Interrupt Request pin for the AT86RF215. The transceiver asserts this 
      pin (active high by default) when a radio event occurs.

  reset-gpios:
    type: phandle-array
    required: true
    description: |
      Hardware reset pin for the AT86RF215. This is an active-low signal 
      used to hard-reset the transceiver during initialization.
```

## software/dts/bindings/can/microchip,mcp251863-probe.yaml
```yaml
description: |
  MCP251863 manual bench transport, used by read-only and internal-loopback tests.
  This diagnostic-only compatible intentionally
  does not bind the production CAN driver, whose initialization writes registers.
compatible: "microchip,mcp251863-probe"
include: spi-device.yaml
properties:
  standby-gpios:
    type: phandle-array
    required: true
    description: External STBY signal, sampled as an input without changing its level.
  int-gpios:
    type: phandle-array
    required: true
    description: Main active-low interrupt signal, sampled as an input only.
```

## software/dts/bindings/radio/microchip,at86rf215.yaml
```yaml
description: AT86RF215 radio accessed by the OCS application driver

compatible: "microchip,at86rf215"

include: spi-device.yaml

properties:
  reset-gpios:
    type: phandle-array
    required: true
    description: Active-low radio reset signal

  irq-gpios:
    type: phandle-array
    required: true
    description: Radio interrupt signal
```

## software/module/at68rf215/drivers/at86rf215/Kconfig
```kconfig
config IEEE802154_AT86RF215
	bool "AT86RF215 IEEE 802.15.4 Transceiver driver"
	default y
	depends on DT_HAS_ATMEL_AT86RF215_ENABLED
	select GPIO
	select SPI
	select EVENTS
	help
	  Enable support for the Microchip/Atmel AT86RF215 transceiver driver.

config IEEE802154_AT86RF215_INIT_PRIORITY
	int "AT86RF215 init priority"
	default 80
	depends on IEEE802154_AT86RF215
	help
	  Device init priority. The driver talks to the chip during init, so this
	  must be higher (later) than SPI_INIT_PRIORITY.
```

## software/module/at68rf215/dts/bindings/atmel,at86rf215.yaml
```yaml
description: Atmel AT86RF215 Dual-band IEEE 802.15.4 / Sub-GHz Transceiver

compatible: "atmel,at86rf215"

include: spi-device.yaml

properties:
  irq-gpios:
    type: phandle-array
    required: true
    description: |
      Interrupt Request pin for the AT86RF215. The transceiver asserts this 
      pin (active high by default) when a radio event occurs.

  reset-gpios:
    type: phandle-array
    required: true
    description: |
      Hardware reset pin for the AT86RF215. This is an active-low signal 
      used to hard-reset the transceiver during initialization.

  rf09-base-freq-hz:
    type: int
    required: true
    description: |
      Frequency of channel 0 on the sub-1GHz radio, in Hz. Depends on the
      board and the region. Must be a multiple of 25 kHz inside the chip's
      bands, or init fails.

  rf09-channel-spacing-hz:
    type: int
    required: true
    description: |
      Spacing between channels on the sub-1GHz radio, in Hz. Must be a
      multiple of 25 kHz, up to 6.375 MHz, or init fails.
```

## software/tests/software/can_probe/testcase.yaml
```yaml
tests:
  ocs.can.probe:
    harness: ztest
    platform_allow:
      - qemu_cortex_m3/ti_lm3s6965
    tags:
      - can
      - spi
```

## software/tests/software/radio_packet/testcase.yaml
```yaml
tests:
  ocs.radio.packet:
    harness: ztest
    platform_allow:
      - qemu_cortex_m3/ti_lm3s6965
    tags:
      - radio
```

## software/west.yml
```yaml
manifest:
  remotes:
    - name: zephyrproject-rtos
      url-base: https://github.com/zephyrproject-rtos

  projects:
    - name: zephyr
      remote: zephyrproject-rtos
      revision: v4.4.0  # Lock to a specific Zephyr release or commit. Keep in sync with flake.nix
      import:           # Only pull in the dependencies the SAMD21 needs
        name-allowlist:
          - cmsis
          - cmsis_6
          - hal_atmel

  self:
    path: software
```
